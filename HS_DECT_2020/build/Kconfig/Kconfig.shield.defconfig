## HS_DECT_2020/build/Kconfig/Kconfig.shield.defconfig
```kconfig
osource "/home/ashuqullah-alizai/ncs/v3.1.1/nrf/boards/shields/*/Kconfig.defconfig"
```

## HS_DECT_2020/build/Kconfig/boards/Kconfig
```kconfig
# Load Zephyr board Kconfig descriptions.
osource "/home/ashuqullah-alizai/ncs/v3.1.1/zephyr/boards/nordic/nrf9161dk/Kconfig"
config BOARD_REVISION_0_9_0
	def_bool y
```

## HS_DECT_2020/build/Kconfig/boards/Kconfig.defconfig
```kconfig
# Load Zephyr board defconfig descriptions.
osource "/home/ashuqullah-alizai/ncs/v3.1.1/zephyr/boards/nordic/nrf9161dk/Kconfig.defconfig"
```

## HS_DECT_2020/build/Kconfig/boards/Kconfig.sysbuild
```kconfig
# Load Sysbuild board Kconfig descriptions.
osource "/home/ashuqullah-alizai/ncs/v3.1.1/zephyr/boards/nordic/nrf9161dk/Kconfig.sysbuild"
```

## HS_DECT_SHELL/build/HS_DECT_SHELL/Kconfig/boards/Kconfig.nrf9151dk
```kconfig
# Load board Kconfig descriptions.
osource "/home/ashuqullah-alizai/ncs/v3.1.1/zephyr/boards/nordic/nrf9151dk/Kconfig.nrf9151dk"
```
