## CMakeLists.txt
```
cmake_minimum_required(VERSION 3.20.0)

find_package(Zephyr REQUIRED HINTS $ENV{ZEPHYR_BASE})
project(HS_DECT_2020)

# Let the src/ directory manage its own sources
add_subdirectory(src)
```

## Kconfig
```
#
# Copyright (c) 2024 Nordic Semiconductor
#
# SPDX-License-Identifier: LicenseRef-Nordic-5-Clause
#

config CARRIER
	int "Carrier to use"
	default 0
	help
	   The availability of the channels and the exact regulation to use them varies in different countries.
	   See ETSI TS 103 636-2 5.4.2 for the calculation.
	   Band index 1 is set when the carrier is within the range of 525 to 551.
	   This is the only range allowed for band index 1 as other carriers will interfere with other radio devices, including LTE devices.

config NETWORK_ID
	int "Network ID"
	range 1 4294967295
	default 91

config MCS
	int "MCS"
	default 1
	help
	   The MCS impacts how much data can fit into each subslot.

config TX_POWER
	int "TX power"
	range 0 13
	default 13
	help
	   Transmission power, max 19 dBm due to hardware limitations.
	   See table 6.2.1-3 of ETSI TS 103 636-4 v1.5.1.

config TX_TRANSMISSIONS
	int "TX transmissions"
	range 0 4294967295
	default 1
	help
	   Transmissions before sample exits, use 0 to transmit forever.

config RX_PERIOD_S
	int "RX period"
	default 1
	help
	   Receive window period.
	   Time is given in seconds.

module = DECT_PHY_HELLO
module-str = DECT NR+ PHY Hello
source "${ZEPHYR_BASE}/subsys/logging/Kconfig.template.log_config"

menu "Zephyr Kernel"
source "Kconfig.zephyr"
endmenu
```

## prj.conf
```kconfig
CONFIG_NRF_MODEM_LIB=y

CONFIG_MODEM_ANTENNA=n

CONFIG_NRF_MODEM_LINK_BINARY_DECT_PHY=y
CONFIG_HWINFO=y

CONFIG_LOG=y

CONFIG_CARRIER=1677
CONFIG_PRINTK=y
CONFIG_CONSOLE=y
# Basic console + UART
CONFIG_CONSOLE=y
CONFIG_UART_CONSOLE=y
CONFIG_SERIAL=y

# Enable Zephyr shell
CONFIG_SHELL=y
CONFIG_SHELL_BACKEND_SERIAL=y

# (Optional but recommended)
CONFIG_SHELL_STACK_SIZE=4096
CONFIG_SHELL_PROMPT_UART="uart:~$ "
```

## src/main.c
```c
#include <zephyr/kernel.h>
#include <zephyr/sys/printk.h>

#include "hello.h"
#include "hs_shell.h"
#include "core.h"


void main(void)
{
    printk("HS_DECT: main() started\n");
    printk("Thanks fo beeing with us in this project !!!!!!!!!!!!!!!!!!!!!!!!!!!!\n");
   // hs_shell_init();   // <-- enable shell commands

    // Start hello DECT
    //hello_start();
	//hello_start_ondemond();
    /*
    while (1) {
        k_sleep(K_SECONDS(1));
    } 
    
    
    */
    
}
```
