## HS_DECT_Mesh/build/HS_DECT_Mesh/Kconfig/Kconfig.shield.defconfig
```kconfig
osource "/home/ashuqullah-alizai/Documents/DECT_2020_GIT/boards_ncs_3_3/boards/shields/*/Kconfig.defconfig"
osource "/home/ashuqullah-alizai/Documents/DECT_2020_GIT/HS_DECT_Mesh/boards/shields/*/Kconfig.defconfig"
osource "/home/ashuqullah-alizai/ncs/v3.3.0/nrf/boards/shields/*/Kconfig.defconfig"
```

## HS_DECT_Mesh/build/Kconfig/boards/Kconfig.defconfig.tmp
```kconfig
# Load Zephyr board defconfig descriptions.
osource "/home/ashuqullah-alizai/Documents/DECT_2020_GIT/boards_ncs_3_3/boards/nrf9151_connectkit/Kconfig.defconfig"
```

## HS_DECT_SHELL/boards /debut_module2/Kconfig.defconfig
```kconfig
# DEBUT DECT NR+ Module board configuration

# Copyright (c) 2025 PHYTEC Messtechnik GmbH
#
config HW_STACK_PROTECTION
	default ARCH_HAS_STACK_PROTECTION

if CONFIG_BOARD_DEBUT_MODULE_NRF9151_NS || CONFIG_BOARD_DEBUT_MODULE_NRF9151

config BOARD_DEBUT_MODULE
	select USE_DT_CODE_PARTITION if BOARD_DEBUT_MODULE_NRF9151_NS

config BT_HCI_VS
	default y if BT

endif # BOARD_DEBUT_MODULE_NRF9151_NS || CONFIG_BOARD_DEBUT_MODULE_NRF9151
```

## HS_DECT_SHELL/build/Kconfig/Kconfig.shield
```kconfig
osource "/home/ashuqullah-alizai/Documents/DECT_2020_GIT/dect_shell/boards/shields/*/Kconfig.shield"
osource "/home/ashuqullah-alizai/ncs/v3.1.1/nrf/boards/shields/*/Kconfig.shield"
```

## HS_DECT_SHELL/build/Kconfig/Kconfig.shield.defconfig
```kconfig
osource "/home/ashuqullah-alizai/Documents/DECT_2020_GIT/dect_shell/boards/shields/*/Kconfig.defconfig"
osource "/home/ashuqullah-alizai/ncs/v3.1.1/nrf/boards/shields/*/Kconfig.defconfig"
```

## dect_Performance/build/dect_Performance/Kconfig/boards/Kconfig.defconfig
```kconfig
# Load Zephyr board defconfig descriptions.
osource "/home/ashuqullah-alizai/Documents/DECT_2020_GIT/dect_shell/boards/nrf9151_connectkit/Kconfig.defconfig"
```

## dect_shell/build/Kconfig/Kconfig.shield
```kconfig
osource "/home/ashuqullah-alizai/Documents/DECT_2020_GIT/HS_DECT_SHELL/boards/shields/*/Kconfig.shield"
osource "/home/ashuqullah-alizai/ncs/v3.3.0/nrf/boards/shields/*/Kconfig.shield"
```

## dect_shell/build/Kconfig/Kconfig.shield.defconfig
```kconfig
osource "/home/ashuqullah-alizai/Documents/DECT_2020_GIT/dect_shell/boards/shields/*/Kconfig.defconfig"
osource "/home/ashuqullah-alizai/ncs/v3.3.0/nrf/boards/shields/*/Kconfig.defconfig"
```

## dect_shell/build/Kconfig/boards/Kconfig
```kconfig
# Load Zephyr board Kconfig descriptions.
osource "/home/ashuqullah-alizai/Documents/DECT_2020_GIT/HS_DECT_SHELL/boards/debut_module/Kconfig"
```

## dect_shell/build/Kconfig/boards/Kconfig.sysbuild.tmp
```kconfig
# Load Sysbuild board Kconfig descriptions.
osource "/home/ashuqullah-alizai/Documents/DECT_2020_GIT/HS_DECT_SHELL/boards/debut_module/Kconfig.sysbuild"
```

## dect_shell/build/dect_shell/Kconfig/Kconfig.shield
```kconfig
osource "/home/ashuqullah-alizai/Documents/DECT_2020_GIT/dect_shell/boards/shields/*/Kconfig.shield"
osource "/home/ashuqullah-alizai/ncs/v3.3.0/nrf/boards/shields/*/Kconfig.shield"
```

## dect_shell/build/dect_shell/Kconfig/boards/Kconfig.sysbuild
```kconfig
# Load Sysbuild board Kconfig descriptions.
osource "/home/ashuqullah-alizai/ncs/v3.3.0/zephyr/boards/nordic/nrf9151dk/Kconfig.sysbuild"
```

## dect_shell/build/dect_shell/Kconfig/boards/Kconfig.sysbuild.tmp
```kconfig
# Load Sysbuild board Kconfig descriptions.
osource "/home/ashuqullah-alizai/Documents/DECT_2020_GIT/dect_shell/boards/nrf9151_connectkit/Kconfig.sysbuild"
```

## hello_dect/boards/debut_module/board.yml
```yaml
board:
  name: debut_module
  full_name: DEBUT DECT NR+ Module
  vendor: nordic
  socs:
  - name: nrf9151
    variants:
    - name: 'ns'
```

## hello_dect/build/Kconfig/boards/Kconfig.defconfig.tmp
```kconfig
# Load Zephyr board defconfig descriptions.
osource "/home/ashuqullah-alizai/ncs/v3.3.0/zephyr/boards/nordic/nrf9151dk/Kconfig.defconfig"
```

## hello_dect/build_1/Kconfig/Kconfig.shield
```kconfig
osource "/home/ashuqullah-alizai/Documents/DECT_2020_GIT/hello_dect/boards/shields/*/Kconfig.shield"
osource "/home/ashuqullah-alizai/ncs/v3.3.0/nrf/boards/shields/*/Kconfig.shield"
```

## hello_dect/build_1/hello_dect/Kconfig/Kconfig.shield.defconfig
```kconfig
osource "/home/ashuqullah-alizai/Documents/DECT_2020_GIT/hello_dect/boards/shields/*/Kconfig.defconfig"
osource "/home/ashuqullah-alizai/ncs/v3.3.0/nrf/boards/shields/*/Kconfig.defconfig"
```
